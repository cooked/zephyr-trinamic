## CMakeLists.txt
```
# SPDX-License-Identifier: Apache-2.0

# Add the driver directory as a zephyr module by hand
list(APPEND ZEPHYR_EXTRA_MODULES
	${CMAKE_CURRENT_SOURCE_DIR}/../drivers/sensors/ad5423
)

list(APPEND OVERLAY_CONFIG
	${CMAKE_CURRENT_SOURCE_DIR}/../drivers/sensors/ad5423/ad5423.conf
)

# Re-direct the directory where the 'boards' directory is found from
# $ZEPHYR_BASE to this directory.
#set(BOARD_ROOT ${CMAKE_CURRENT_LIST_DIR})
set(BOARD_ROOT ${CMAKE_CURRENT_SOURCE_DIR}/..)
# This sample is only compatible with our board because it has
# re-directed the 'boards' directory to a directory that only contains
# this board.
set(BOARD letitbeat_f446ze)


cmake_minimum_required(VERSION 3.20.0)

# required for apps
find_package(Zephyr REQUIRED HINTS $ENV{ZEPHYR_BASE})

project(application_letitbeat)

zephyr_include_directories(src)


# Note that here, we're adding CMAKE_SOURCE_DIR to the include path for nanopb.
# This is needed because the below call to nanopb_generate_cpp() is using
# 'RELPATH .'
set(NANOPB_OPTIONS "-I${CMAKE_SOURCE_DIR}")
nanopb_generate_cpp(proto_sources proto_headers RELPATH .
    src/simple.proto
)
# we need to be able to include generated header files
zephyr_library_include_directories(${CMAKE_CURRENT_BINARY_DIR})

#FILE(GLOB app_sources src/*.c)
#target_sources(app PRIVATE ${proto_sources} ${app_sources})
target_sources(app PRIVATE
	src/main.c
	src/led.c
	src/com.c
	#src/sens.c
	src/shell.c
)
```

## prj.conf
```kconfig
CONFIG_GPIO=y
CONFIG_SENSOR=y
CONFIG_PRINTK=y

CONFIG_LOG=y
CONFIG_LOG_MODE_IMMEDIATE=y
CONFIG_CBPRINTF_FP_SUPPORT=y

CONFIG_SHELL=y

CONFIG_SERIAL=y
CONFIG_CONSOLE=y

# com stack
CONFIG_USB_DEVICE_STACK=y
CONFIG_USB_DEVICE_INITIALIZE_AT_BOOT=y
#CONFIG_USB_DEVICE_PRODUCT="Zephyr Console"

#CONFIG_UART_INTERRUPT_DRIVEN=y
CONFIG_UART_LINE_CTRL=y

# protobuf
CONFIG_NANOPB=y

# enable custom sensors
#CONFIG_AD5423=y
```

## boards/nucleo_f446ze.overlay
```dts
/ {
	chosen {
		zephyr,console = &cdc_acm_uart0;
	};
};

&zephyr_udc0 {
	cdc_acm_uart0: cdc_acm_uart0 {
		compatible = "zephyr,cdc-acm-uart";
	};
};
```

## src/main.c
```c
/*
 * Copyright (c) 2022 Anything Connected
 *
 * SPDX-License-Identifier: Apache-2.0
 */

#include <zephyr/logging/log.h>
LOG_MODULE_REGISTER(main_firmware, LOG_LEVEL_DBG);

#include <stdio.h>
#include <stdlib.h>

#include <zephyr/kernel.h>

// local headers
#include "common.h"
#include "led.h"
#include "com.h"
//#include "sens.h"

enum conn_state connected_global = STATE_NOT_CONNECTED;

#define STACKSIZE 		1024
#define STACKSIZE_HI 	4096

#define SAMPLE_T 100

#define SLEEP_TIME_MS   1000

// threads
K_THREAD_STACK_DEFINE(led_thread_stack_area, 	STACKSIZE);
K_THREAD_STACK_DEFINE(sens_thread_stack_area, 	STACKSIZE);
K_THREAD_STACK_DEFINE(com_thread_stack_area, 	STACKSIZE_HI);

static struct k_thread led_thread_data;
static struct k_thread sens_thread_data;
static struct k_thread com_thread_data;

#define THREAD_PRIORITY_HI 	5
#define THREAD_PRIORITY 	7
#define THREAD_PRIORITY_LOW 9

K_MUTEX_DEFINE(mtx);
struct k_fifo mdata_fifo;

void main(void)
{

	k_fifo_init(&mdata_fifo);

	// LEDs
	k_thread_create(&led_thread_data, led_thread_stack_area, K_THREAD_STACK_SIZEOF(led_thread_stack_area),
		(k_thread_entry_t) thread_led,
		&connected_global, NULL, NULL,
		THREAD_PRIORITY_LOW, 0, K_FOREVER);
	k_thread_name_set(&led_thread_data, "LED thread");
	k_thread_start(&led_thread_data);

	// sensors
	/*k_thread_create(&sens_thread_data, sens_thread_stack_area, K_THREAD_STACK_SIZEOF(sens_thread_stack_area),
		(k_thread_entry_t) thread_sens,
		NULL, &connected_global, &mtx,
		THREAD_PRIORITY, 0, K_FOREVER);
	k_thread_name_set(&sens_thread_data, "SEN thread");
	k_thread_start(&sens_thread_data);*/

	// com
	k_thread_create(&com_thread_data, com_thread_stack_area, K_THREAD_STACK_SIZEOF(com_thread_stack_area),
		(k_thread_entry_t) thread_com,
		NULL, &connected_global, &mtx,
		THREAD_PRIORITY_HI, 0, K_FOREVER);
	k_thread_name_set(&com_thread_data, "COM thread");
	k_thread_start(&com_thread_data);

}
```

## src/com.c
```c
#include <zephyr/logging/log.h>
LOG_MODULE_DECLARE(main_firmware, LOG_LEVEL_DBG);

#include <stdio.h>		// sprintf()
#include <string.h>		// strlen()
#include <time.h>		// gmtime()

#include <zephyr/sys/reboot.h>
//#include <date_time.h>
#include <zephyr/kernel.h>
#include <zephyr/sys/printk.h>
#include <zephyr/usb/usb_device.h>
#include <zephyr/drivers/uart.h>

#include "common.h"
#include "com.h"

// USB
// https://developer.nordicsemi.com/nRF_Connect_SDK/doc/latest/zephyr/samples/subsys/usb/console/README.html

// protobuf
//#include <pb_encode.h>
//#include <pb_decode.h>
//#include "src/simple.pb.h"

extern struct k_fifo mdata_fifo;

//BUILD_ASSERT(DT_NODE_HAS_COMPAT(DT_CHOSEN(zephyr_console), zephyr_cdc_acm_uart),
//	     "Console device is not ACM CDC UART device");

void thread_com(struct k_lifo *data, enum conn_state *conn_state, struct k_mutex *mtx) {

	// TODO
	*conn_state = STATE_NOT_CONNECTED;

	// store date and time
	int64_t 	datetime_ms;
	time_t 		datetime_s;
	struct tm 	*datetime_tm;
	char		datetime_str[DATE_TIME_LEN];


	const struct device *const dev = DEVICE_DT_GET(DT_CHOSEN(zephyr_console));
	uint32_t dtr = 0;

	/*if (usb_enable(NULL)) {
		return;
	}*/

	/* Poll if the DTR flag was set */
	/*while (!dtr) {
		uart_line_ctrl_get(dev, UART_LINE_CTRL_DTR, &dtr);
		// Give CPU resources to low priority threads.
		k_sleep(K_MSEC(100));
	}*/


	while(1) {

		printk("Hello World! %s\n", CONFIG_ARCH);
		k_sleep(K_SECONDS(1));

		// if LIFO empty wait here
		//struct mdata_t *md = k_fifo_get(&mdata_fifo,  K_FOREVER);


		// TODO: move this to the sens thread
		//date_time_now(&datetime_ms);
		//datetime_s 	= datetime_ms/1000;
		//datetime_tm = gmtime(&datetime_s);

		//strftime(datetime_str,DATE_TIME_LEN, "%Y-%m-%d %H:%M:%S.000000", datetime_tm);
		/*char payload[1024]= {"\0"};
		sprintf(payload,"{\"time_measured\":\"%s\"," \
						"\"data\": {" \
						"\"ax\":\"%.3f\",\"ay\":\"%.3f\",\"az\":\"%.3f\"," \
						"\"gx\":\"%.3f\",\"gy\":\"%.3f\",\"gz\":\"%.3f\"," \
						"\"mx\":\"%.3f\",\"my\":\"%.3f\",\"mz\":\"%.3f\"," \
						"\"temp\":\"%.3f\"}}",
						datetime_str,
						sensor_value_to_double(&md->ax),
						sensor_value_to_double(&md->ay),
						sensor_value_to_double(&md->az),
						sensor_value_to_double(&md->gx),
						sensor_value_to_double(&md->gy),
						sensor_value_to_double(&md->gz),
						sensor_value_to_double(&md->mx),
						sensor_value_to_double(&md->my),
						sensor_value_to_double(&md->mz),
						sensor_value_to_double(&md->temp)
		);*/

		// TODO: TX

	}


}
```

## src/com.h
```c
#include <zephyr/kernel.h>

#define MAX_RECV_BUF_LEN 2048

#define DATE_TIME_LEN 27

// Prototypes
void thread_com(struct k_lifo *data, enum conn_state *conn_state, struct k_mutex *mtx);
```

## src/common.h
```c
#include <zephyr/drivers/sensor.h>

enum conn_state {
	STATE_NOT_CONNECTED,
	STATE_LTE_CONNECTED,
	STATE_BACKEND_CONNECTED,
	STATE_ERROR
};

// data structure
struct mdata_t {
	void  *reserved; /* 1st word reserved for use by fifo */
	struct sensor_value ax;
	struct sensor_value ay;
	struct sensor_value az;
	struct sensor_value gx;
	struct sensor_value gy;
	struct sensor_value gz;
	struct sensor_value mx;
	struct sensor_value my;
	struct sensor_value mz;
	struct sensor_value temp;
};
```

## src/led.c
```c
#include <zephyr/logging/log.h>
LOG_MODULE_DECLARE(main_firmware, LOG_LEVEL_DBG);

#include <zephyr/kernel.h>
#include <zephyr/devicetree.h>

#include <zephyr/drivers/gpio.h>

#include "common.h"
#include "led.h"


static const struct gpio_dt_spec led1_r = GPIO_DT_SPEC_GET(LED1_R_NODE, gpios);
static const struct gpio_dt_spec led1_g = GPIO_DT_SPEC_GET(LED1_G_NODE, gpios);
static const struct gpio_dt_spec led1_b = GPIO_DT_SPEC_GET(LED1_B_NODE, gpios);

void timer_expired() {
	//gpio_pin_set_dt(&led1_g, 0);
	gpio_pin_set_dt(&led1_g, 0);
}

K_TIMER_DEFINE(timer, timer_expired, NULL);

int led_off() {
	int ret = 0;
	ret |= gpio_pin_set_dt(&led1_r, 0);
	ret |= gpio_pin_set_dt(&led1_g, 0);
	ret |= gpio_pin_set_dt(&led1_b, 0);
	return ret;
}

void thread_led(enum conn_state *conn_state, void *arg2, void *arg3)
{
	ARG_UNUSED(arg2);
	ARG_UNUSED(arg3);

	printk("LED control starting...\n");

	if(	gpio_pin_configure_dt(&led1_r, GPIO_OUTPUT_ACTIVE) < 0 ||
		gpio_pin_configure_dt(&led1_g, GPIO_OUTPUT_ACTIVE) < 0 ||
		gpio_pin_configure_dt(&led1_b, GPIO_OUTPUT_ACTIVE) < 0 ) {
		return;
	}

	led_off();

	LOG_DBG("Succesfully initialized LED");

	int ret;
	uint8_t prev_state = STATE_NOT_CONNECTED;

	while(1) {

		switch(*conn_state) {
			case STATE_NOT_CONNECTED:
				prev_state = STATE_NOT_CONNECTED;

				ret = gpio_pin_toggle_dt(&led1_b);
				ret = gpio_pin_toggle_dt(&led1_r);
				ret = gpio_pin_toggle_dt(&led1_g);
				k_sleep(K_MSEC(500));
				break;

			case STATE_LTE_CONNECTED:
				prev_state = STATE_LTE_CONNECTED;

				ret = gpio_pin_set_dt(&led1_b, 1);

				k_sleep(K_MSEC(500));
				break;

			case STATE_BACKEND_CONNECTED:
				if( prev_state != STATE_BACKEND_CONNECTED) {

					ret = gpio_pin_set_dt(&led1_b, 0);

					// turn green ON (turned OFF by timer callback)
					k_timer_start(&timer, K_MSEC(5000), K_NO_WAIT);
					//ret = gpio_pin_set_dt(&led1_g, 1);
					ret |= gpio_pin_set_dt(&led1_g, 1);

				}

				prev_state = STATE_BACKEND_CONNECTED;
				break;

			case STATE_ERROR:
				prev_state = STATE_ERROR;

				//ret = gpio_pin_set_dt(&led1_b, 0);
				//ret |= gpio_pin_set_dt(&led2_b, 0);
				//ret |= gpio_pin_toggle_dt(&led1_r);
				ret = gpio_pin_set_dt(&led1_b, 0);
				ret |= gpio_pin_toggle_dt(&led1_r);

				k_sleep(K_MSEC(1000));
				break;
		}

	}

}
```

## src/led.h
```c
#include <zephyr/kernel.h>

// devicetree
#define LED1_R_NODE DT_ALIAS(led0)
#define LED1_G_NODE DT_ALIAS(led1)
#define LED1_B_NODE DT_ALIAS(led2)

#define PERIOD_USEC	(USEC_PER_SEC / 50U)
#define PERIOD_NSEC	(NSEC_PER_USEC * PERIOD_USEC)

#define STEPSIZE_USEC	2000

enum { RED, GREEN, BLUE };

// Prototypes
void thread_led(enum conn_state *conn_state, void *arg2, void *arg3);
```

## src/sens.c
```c
#include <zephyr/logging/log.h>
LOG_MODULE_DECLARE(main_firmware, LOG_LEVEL_DBG);

#include <zephyr/drivers/sensor.h>

#include "ad5423.h"

#include "common.h"
#include "sens.h"

extern struct k_fifo mdata_fifo;

const struct device *dac;

void thread_sens(struct k_lifo *data, enum conn_state *conn_state, struct k_mutex *mtx)
{

	dac = DEVICE_DT_GET_ANY(adi_ad5423);

	//
	//const struct device *ad5423  = device_get_binding("AD5423");

	if (!dac) {
		LOG_ERR("Failed to get device binding for AD5423");
		return;
	}

	struct sensor_value accel[3], gyro[3], mag[4];

	while(1) {

		get_chip_id(dac);
		//printk("SENS \n");

		/*if(*conn_state == STATE_BACKEND_CONNECTED) {

			// get 6DOF
			//sensor_sample_fetch(iim42652);
			//sensor_channel_get(iim42652, SENSOR_CHAN_ACCEL_XYZ, accel);
			//sensor_channel_get(iim42652, SENSOR_CHAN_GYRO_XYZ, gyro);

			// get MAG
			//sensor_sample_fetch(mlx90393);
			//sensor_channel_get(mlx90393, SENSOR_CHAN_ALL, mag);

			struct mdata_t md = {
				.ax = accel[0],
				.ay = accel[1],
				.az = accel[2],
				.gx = gyro[0],
				.gy = gyro[1],
				.gz = gyro[2],
				.mx = mag[0],
				.my = mag[1],
				.mz = mag[2],
				.temp = mag[3]
			};

			k_fifo_put(&mdata_fifo, &md);

		}*/

		// slow down
		k_msleep( 1000 );

	}

}
```

## src/sens.h
```c
//#define THREAD_RATE_S 1
#define THREAD_RATE_10S 	10U
#define THREAD_RATE_30S 	30U
#define THREAD_RATE_1MIN 	60U
#define THREAD_RATE_2MIN 	120U
#define THREAD_RATE_5MIN 	300U
#define THREAD_RATE_10MIN 	600U

#define THREAD_RATE_MS 		THREAD_RATE_10S

// Prototypes
void thread_sens(struct k_lifo *data, enum conn_state *conn_state,
					struct k_mutex *mtx);
```

## src/shell.c
```c
/*
 * Copyright (c) 2022 Wrecklab BV
 *
 * SPDX-License-Identifier: Apache-2.0
 */

#include <stdlib.h>
#include <zephyr/shell/shell.h>

//#include "tmc5160.h"

extern bool toggle;
extern const struct device *tmc;

static int cmd_lib_info(const struct shell *shell, size_t argc, char *argv[])
{
    //slave = (uint8_t) strtol(argv[CMD_ARG_N], &argv[CMD_ARG_N], 10);
	shell_fprintf(shell, SHELL_NORMAL, "Biond L.I.B. init info message %s\n", CONFIG_ARCH);
	//tmc_init(tmc, slave);

    return 0;
}

/*static int cmd_tmc(const struct shell *shell, size_t argc, char *argv[])
{
	slave = (uint8_t) strtol(argv[1], &argv[1], 10);
	return 0;
}
static int cmd_tmc_get(const struct shell *shell, size_t argc, char *argv[])
{
	uint32_t data;

	slave = (uint8_t) strtol(argv[CMD_ARG_N], &argv[CMD_ARG_N], 10);
	attr f = get_field(argv[CMD_ARG_N+1]);

	tmc_reg_read(tmc, slave, f.reg, &data);

	shell_fprintf(shell, SHELL_NORMAL, "GET - Field '%s' (reg 0x%02X) has value: %u \n", argv[CMD_ARG_N+1], f.reg, (data&f.mask)>>f.shift);

	//shell_fprintf(shell, SHELL_NORMAL, "GET - Field '%s' (reg 0x%02X) has value: %u \n", argv[CMD_ARG_N+1], f.reg, (data&f.mask)>>f.shift);

    return 0;
}
static int cmd_tmc_set(const struct shell *shell, size_t argc, char *argv[])
{
	uint32_t data;

	slave = (uint8_t) strtol(argv[CMD_ARG_N], &argv[CMD_ARG_N], 10);
	attr f = get_field(argv[CMD_ARG_N+1]);

	int32_t val = strtol(argv[CMD_ARG_N+2], &argv[CMD_ARG_N+2], 10);

	//tmc_reg_read(tmc, slave, f.reg, &data);
	//data &= ~f.mask;
	//data |= val<<f.shift;
	//tmc_reg_write(tmc, slave, f.reg, data);

	tmc_reg_write(tmc, slave, f.reg, val);

	shell_fprintf(shell, SHELL_NORMAL,
		"SET - Field '%s' (reg 0x%02X) set to value 0x%04X \n", argv[CMD_ARG_N+1], f.reg, val);


    return 0;
}
static int cmd_tmc_dump(const struct shell *shell, size_t argc, char *argv[])
{

	slave = (uint8_t) strtol(argv[CMD_ARG_N], &argv[CMD_ARG_N], 10);
    shell_fprintf(shell, SHELL_NORMAL, "TMC dump slave %u registers: \n", slave);

	tmc_dump(tmc, slave);

	return 0;
}
static int cmd_tmc_run(const struct shell *shell, size_t argc, char *argv[])
{
	// TODO: add a second parameter for acceleration

	int32_t rpm = (int32_t) strtol( argv[CMD_ARG_N+1], &argv[CMD_ARG_N+1], 10);
	int32_t acc = 0;

	if(argc == CMD_ARG_N+2)
		acc = (int32_t) strtol( argv[CMD_ARG_N+1], &argv[CMD_ARG_N+1], 10);

	slave = (uint8_t) strtol(argv[CMD_ARG_N], &argv[CMD_ARG_N], 10);

	tmc_run(tmc, slave, rpm, acc);

	shell_fprintf(shell, SHELL_NORMAL, "Run motor at %d rpm\n", rpm);

    return 0;
}
static int cmd_tmc_mode(const struct shell *shell, size_t argc, char *argv[])
{
    shell_fprintf(shell, SHELL_NORMAL, "TMC query <field_name>: %d\n", 0);
    return 0;
}
static int cmd_tmc_turn(const struct shell *shell, size_t argc, char *argv[])
{

	slave = (uint8_t) strtol(argv[CMD_ARG_N], &argv[CMD_ARG_N], 10);

	// increment/decrement current position by n (float) turns
	int32_t acc, speed;

	if(argc == CMD_ARG_N+3) {
		acc = (int32_t) strtol( argv[CMD_ARG_N+3], &argv[CMD_ARG_N+3], 10);
		tmc_set_amax(tmc, slave, acc);
		speed = (int32_t) strtol( argv[CMD_ARG_N+2], &argv[CMD_ARG_N+2], 10);
		tmc_set_vmax(tmc, slave, speed);
	} else if(argc == CMD_ARG_N+2) {
		speed = (int32_t) strtol( argv[CMD_ARG_N+2], &argv[CMD_ARG_N+2], 10);
		tmc_set_vmax(tmc, slave, speed);
	}

	//float turns = strtod(argv[1], &argv[1]);
	int32_t turns = (int32_t) strtol( argv[CMD_ARG_N+1], &argv[CMD_ARG_N+1], 10);

	int32_t steps = tmc_get_xtarget(tmc, slave);
	steps += (int32_t) (turns * DEFAULT_STEPS_TURN);

	tmc_set_xtarget(tmc, slave, 51200);

	return 0;
}

static int cmd_tmc_goto(const struct shell *shell, size_t argc, char *argv[])
{
	// rotate to absolute position [turns]

	//float turns = strtod(argv[1], &argv[1]);
	int32_t turns = (int32_t) strtol( argv[1], &argv[1], 10);

	int32_t steps = (int32_t) (turns * DEFAULT_STEPS_TURN);
	// TODO:
	//tmc_set_xtarget(tmc, slave, steps);

	return 0;
}
static int cmd_tmc_cur(const struct shell *shell, size_t argc, char *argv[])
{

	uint8_t irun = (uint8_t) strtol( argv[CMD_ARG_N+1], &argv[CMD_ARG_N+1], 10);
	uint8_t ihold = (uint8_t) strtol( argv[CMD_ARG_N+2], &argv[CMD_ARG_N+2], 10);

	slave = (uint8_t) strtol(argv[CMD_ARG_N], &argv[CMD_ARG_N], 10);

	tmc_set_irun_ihold(tmc, slave, irun, ihold);

	shell_fprintf(shell, SHELL_NORMAL, "Set TMC current I_RUN: %u, I_HOLD: %u \n", irun, ihold);

	return 0;
}
*/

SHELL_STATIC_SUBCMD_SET_CREATE( lib_cmds,

	SHELL_CMD_ARG(info, NULL, "Get version and other info",
		cmd_lib_info, 1, 0),

	/*SHELL_CMD_ARG(dump, NULL, "Printout slave readable registers",
		cmd_tmc_dump, 2, 0),
	// run (start/stop)
	SHELL_CMD_ARG(run, NULL, "Start/Stop TMC stepper (at <rpm_speed>, optional accel)",
		cmd_tmc_run, 3, 1),
	// set mode (ramp or velocity)
	SHELL_CMD_ARG(mode, NULL, "Set TMC mode of operation. ($ tmc mode <slave> <0/1> // 0:velocity 1:ramp)",
		cmd_tmc_mode, 2, 0),
	// set/get register's field
	SHELL_CMD_ARG(get, NULL,	"Get TMC register's field (tmc get <slave> <field>)",
		cmd_tmc_get, 3, 0),
	SHELL_CMD_ARG(set, NULL,	"Set TMC register's field (tmc set <slave> <field> <value>)",
		cmd_tmc_set, 4, 0),
	SHELL_CMD_ARG(turn, NULL,	"Turn motor by n turns (1.5: increment, -1.5: decrement)",
		cmd_tmc_turn, 3, 2),
	SHELL_CMD_ARG(goto, NULL,	"Move TMC to position",
		cmd_tmc_goto, 2, 0),
	SHELL_CMD_ARG(cur, NULL, 	"Set TMC run and hold current (0:min, 31:max)",
		cmd_tmc_cur, 4, 0),*/

	SHELL_SUBCMD_SET_END
);

// [0] [1]         [2]
// tmc <slaveaddr> <subcmd>
SHELL_CMD_ARG_REGISTER(lib, &lib_cmds, "Biond Let It Beat control commands", NULL, 1, 0);
```

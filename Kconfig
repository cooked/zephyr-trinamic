## Kconfig
```kconfig
# Copyright (c) 2023 Stefano Cottafavi
# SPDX-License-Identifier: Apache-2.0

rsource "drivers/Kconfig"
```

## boards/arm/printhat1/Kconfig.board
```kconfig
# printHAT v2 board configuration

# Copyright (c) 2022 Stefano Cottafavi
# SPDX-License-Identifier: Apache-2.0

config BOARD_PRINTHAT1
	bool "printHAT v1 Motion Control Board"
	depends on SOC_STM32F103XB
```

## boards/arm/printhat1/Kconfig.defconfig
```kconfig
# Copyright (c) 2022 Stefano Cottafavi
# SPDX-License-Identifier: Apache-2.0

if BOARD_PRINTHAT1

config BOARD
	default "printhat1"

config SPI_STM32_INTERRUPT
	default y
	depends on SPI

endif # BOARD_PRINTHAT1
```

## boards/arm/printhat2/Kconfig.board
```kconfig
# printHAT v2 board configuration

# Copyright (c) 2022 Stefano Cottafavi
# SPDX-License-Identifier: Apache-2.0

config BOARD_PRINTHAT2
	bool "printHAT v2 Motion Control Board"
	depends on SOC_STM32F401XE
```

## boards/arm/printhat2/Kconfig.defconfig
```kconfig
# NUCLEO-64 F401RE board configuration

# Copyright (c) 2022 Stefano Cottafavi
# SPDX-License-Identifier: Apache-2.0

if BOARD_PRINTHAT2

config BOARD
	default "printhat2"

config SPI_STM32_INTERRUPT
	default y
	depends on SPI

endif # BOARD_PRINTHAT2
```

## drivers/Kconfig
```kconfig
menu "TRINAMIC drivers"

config TMC_SD
	bool "Use STEP/DIR mode"

config TMC_SPI
	bool "Use SPI"

config TMC_UART
	bool "Use UART"

rsource "tmc2130/Kconfig"
rsource "tmc2209/Kconfig"
rsource "tmc5160/Kconfig"

endmenu
```

## drivers/tmc2130/Kconfig
```kconfig
# Copyright (c) 2022, Stefano Cottafavi <stefano.cottafavi@gmail.com>
#
# SPDX-License-Identifier: Apache-2.0

menuconfig TMC2130
	bool "Enable support for the TMC2130 stepper driver"
	default y
	depends on DT_HAS_TRINAMIC_TMC2130_ENABLED
	select HAS_TMCLIB
	select SPI if $(dt_compat_on_bus,$(DT_COMPAT_TRINAMIC_TMC2130),spi)
	select TMC_SPI if $(dt_compat_on_bus,$(DT_COMPAT_TRINAMIC_TMC2130),spi)

	help
		Enable driver for TMC2130 stepper driver.

if TMC2130

# TODO: diag pins and others

endif # TMC2130
```

## drivers/tmc2209/Kconfig
```kconfig
# Copyright (c) 2022, Stefano Cottafavi <stefano.cottafavi@gmail.com>
#
# SPDX-License-Identifier: Apache-2.0

menuconfig TMC2209
	bool "Enable support for the TMC2209 stepper driver"
	default y
	depends on DT_HAS_TRINAMIC_TMC2209_ENABLED
	select HAS_TMCLIB
	select SERIAL if $(dt_compat_on_bus,$(DT_COMPAT_TRINAMIC_TMC2209),uart)
	select TMC_UART if $(dt_compat_on_bus,$(DT_COMPAT_TRINAMIC_TMC2209),uart)
	help
		Enable driver for TMC2209 stepper driver.

if TMC2209

# TODO: add diag pin

endif # TMC2209
```

## drivers/tmc5160/Kconfig
```kconfig
# Copyright (c) 2022, Stefano Cottafavi <stefano.cottafavi@gmail.com>
#
# SPDX-License-Identifier: Apache-2.0

menuconfig TMC5160
	bool "Enable support for the TMC5160 stepper driver"
	default y
	depends on DT_HAS_TRINAMIC_TMC5160_ENABLED
	select HAS_TMCLIB
	select SPI if $(dt_compat_on_bus,$(DT_COMPAT_TRINAMIC_TMC5160),spi)
	select TMC_SPI if $(dt_compat_on_bus,$(DT_COMPAT_TRINAMIC_TMC5160),spi)
	select SERIAL if $(dt_compat_on_bus,$(DT_COMPAT_TRINAMIC_TMC5160),uart)
	select TMC_UART if $(dt_compat_on_bus,$(DT_COMPAT_TRINAMIC_TMC5160),uart)
	help
		Enable driver for TMC5160 stepper driver.

if TMC5160

# TODO: add diag pin

endif # TMC5160
```

## drivers/tmc5160/dts/bindings/trinamic,tmc5160-spi.yaml
```yaml
# Copyright (c) 2022, Stefano Cottafavi <stefano.cottafavi@gmail.com>
#
# SPDX-License-Identifier: Apache-2.0

description: TMC5160 stepper driver (SPI)

compatible: "trinamic,tmc5160"

include: spi-device.yaml

properties:
  diag0-pin:
    type: phandles
    description: |
      Diagnostic pin 0
  diag1-pin:
    type: phandles
    description: |
      Diagnostic pin 1
  r-sens:
    type: int
    description: |
      Sensing resistor [mohm]
    default: 110
  current-run:
    type: int
    description: |
      Operating current [mA]
    default: 1000
  current-hold:
    type: int
    description: |
      Holding current [mA]
    default: 200

  rotation-distance:
    type: int
    description: |
      Linear displacement per motor turn [mm]
    default: 1000
```

## drivers/tmc5160/dts/bindings/trinamic,tmc5160-uart.yaml
```yaml
# Copyright (c) 2022 Wrecklab BV
# SPDX-License-Identifier: Apache-2.0

description: TMC5160 stepper driver (UART)

compatible: "trinamic,tmc5160"

include: uart-device.yaml

properties:
  diag0-pin:
    type: phandles
    description: |
      Diagnostic pin 0
  diag1-pin:
    type: phandles
    description: |
      Diagnostic pin 1
  r-sens:
    type: int
    description: |
      Sensing resistor [mohm]
    default: 110
  current-run:
    type: int
    description: |
      Operating current [mA]
    default: 1000
  current-hold:
    type: int
    description: |
      Holding current [mA]
    default: 200

  rotation-distance:
    type: int
    description: |
      Linear displacement per motor turn [mm]
    default: 1000
```

## dts/bindings/trinamic,tmc.yml
```yaml
# Copyright (c) 2022, Stefano Cottafavi <stefano.cottafavi@gmail.com>
#
# SPDX-License-Identifier: Apache-2.0

properties:
  pwms:
    type: phandle-array
    description: |
      Step pin

  dir-gpios:
    type: phandle-array
    description: |
      Dir pin

  en-gpios:
    type: phandle-array
    description: |
      Enable pin

  diag0-pin:
    type: phandles
    description: |
      Diagnostic pin 0
  diag1-pin:
    type: phandles
    description: |
      Diagnostic pin 1

  r-sens:
    type: int
    description: |
      Sensing resistor [mohm]
    default: 110
  current-run:
    type: int
    description: |
      Operating current [1-32]
    default: 10
  current-hold:
    type: int
    description: |
      Holding current [1-32]
    default: 5

  rotation-distance:
    type: int
    description: |
      Linear displacement per motor turn [mm]
    default: 1000
```

## dts/bindings/trinamic,tmc2130-spi.yml
```yaml
# Copyright (c) 2022, Stefano Cottafavi <stefano.cottafavi@gmail.com>
#
# SPDX-License-Identifier: Apache-2.0

description: TMC2130 stepper driver (SPI)

compatible: "trinamic,tmc2130"

include: [ "spi-device.yaml", "trinamic,tmc.yml"]
```

## manifest-devel/west.yml
```yaml
manifest:

  self:
    path: zephyr-trinamic

  remotes:
    - name: zephyr
      url-base: https://github.com/zephyrproject-rtos
    - name: trinamic
      url-base: https://github.com/cooked

  projects:
    - name: zephyr
      remote: zephyr
      revision: main
      path: rtos
      import:
        name-allowlist:
          - cmsis
          - hal_stm32

    - name: hal_tmc
      remote: trinamic
      repo-path: TMC-API
      path: modules/hal/tmc
      revision: zephyr
```

## west.yml
```yaml
# https://docs.zephyrproject.org/3.1.0/develop/west/manifest.html

# https://github.com/zephyrproject-rtos/zephyr/issues/35075

manifest:

  self:
    path: zephyr-trinamic

  remotes:
    - name: zephyr
      url-base: https://github.com/zephyrproject-rtos
    - name: trinamic
      url-base: https://github.com/cooked

  projects:
    - name: zephyr
      remote: zephyr
      repo-path: zephyr
      revision: main
      import:
        name-allowlist:
          - cmsis
          - hal_stm32

    - name: hal_tmc
      remote: trinamic
      repo-path: TMC-API
      path: modules/hal/tmc
      revision: zephyr
```
